## drivers/sdio_dc/Kconfig
```kconfig
# Copyright 2026 Nordic Semiconductor ASA
# SPDX-License-Identifier: Apache-2.0

menuconfig SDIO_DC
	bool "SDIO device controller drivers"
	help
	  Enable the SDIO device controller (slave/peripheral side) driver
	  class. SDIO device controllers answer commands from a remote SDIO
	  host and are the counterpart of SD host controllers (SDHC).

if SDIO_DC

module = SDIO_DC
module-str = SDIO device controller
source "subsys/logging/Kconfig.template.log_config"

config SDIO_DEVICE_INIT_PRIORITY
	int "SDIO device controller init priority"
	default 70
	help
	  Device initialization priority for SDIO device controllers.

config SDIO_DC_VIRTUAL
	bool "Virtual (loopback) SDIO device controller"
	default y
	depends on DT_HAS_ZEPHYR_SDIO_DEVICE_VIRTUAL_ENABLED
	help
	  Software-only SDIO device controller that also exposes an in-process
	  loopback transport for a host-role endpoint. Intended for tests and
	  samples on platforms without SDIO hardware.

config SDIO_DC_RW6XX
	bool "NXP RW6xx SDIO device controller"
	default y
	depends on DT_HAS_NXP_RW6XX_SDIO_DEVICE_ENABLED
	help
	  Expose the NXP RW6xx SDIO device controller through the role-neutral
	  SDIO device-controller class, backed by the sdio_dev mcux component
	  (fsl_adapter_sdu) from hal_nxp.

endif # SDIO_DC
```

## dts/bindings/sdio_dc/nxp,rw6xx-sdio-device.yaml
```yaml
# Copyright 2026 Nordic Semiconductor ASA
# SPDX-License-Identifier: Apache-2.0

description: |
  NXP RW6xx SDIO device controller (slave side), exposed through the
  role-neutral SDIO device-controller class, backed by the sdio_dev mcux
  component (fsl_adapter_sdu) from hal_nxp.

compatible: "nxp,rw6xx-sdio-device"

include: base.yaml

properties:
  reg:
    required: true

  interrupts:
    required: true

  num-functions:
    type: int
    default: 1
    description: Number of I/O functions exposed to the host (1-7).

  max-block-size:
    type: int
    default: 512
    description: Maximum block size for block-mode transfers.

  cccr-addr:
    type: int
    default: 0
    description: Base address of the Card Common Control Registers window.

  data-port-reg:
    type: int
    default: 0
    description: Register offset used as the streaming data port / FIFO.
```

## subsys/sdio/Kconfig
```kconfig
# Copyright 2026 Nordic Semiconductor ASA
# SPDX-License-Identifier: Apache-2.0

# Role-neutral SDIO subsystem configuration

menuconfig SDIO
	bool "Role-neutral SDIO subsystem"
	help
	  Enable the standalone, role-neutral SDIO subsystem. Unlike the
	  SD-card centered SDIO protocol support (SDIO_STACK), this subsystem
	  models SDIO as a general transport with explicit host and
	  device/slave roles, decoupled from struct sd_card.

if SDIO

module = SDIO
module-str = SDIO subsystem
source "subsys/logging/Kconfig.template.log_config"

config SDIO_LOCK_TIMEOUT_MS
	int "SDIO bus lock timeout (ms)"
	default 500
	help
	  Maximum time to wait for the per-endpoint bus lock when issuing a
	  function I/O operation.

config SDIO_HOST
	bool "SDIO host role"
	depends on SDHC
	help
	  Enable the host-role transport backend. An SDIO host endpoint drives
	  the bus through a Zephyr SD host controller (SDHC).

if SDIO_HOST

config SDIO_HOST_CMD_TIMEOUT_MS
	int "SDIO host command timeout (ms)"
	default 200

config SDIO_HOST_DATA_TIMEOUT_MS
	int "SDIO host data timeout (ms)"
	default 5000

endif # SDIO_HOST

config SDIO_DEVICE
	bool "SDIO device/slave role"
	depends on SDIO_DC
	help
	  Enable the device/slave-role subsystem. An SDIO device endpoint
	  exposes function I/O space, register windows and FIFOs to a remote
	  SDIO host through an SDIO device controller (SDIO_DC).

if SDIO_DEVICE

config SDIO_DEVICE_STREAM
	bool "SDIO device streaming (packet/poll) extension"
	select POLL
	help
	  Optional pooled-packet data path with RX/TX FIFOs and a poll() wait,
	  layered on top of an SDIO device function. Intended for high-throughput
	  companion transports (Wi-Fi/BT). Adapted from the NXP sd_dev proposal.

if SDIO_DEVICE_STREAM

config SDIO_STREAM_PKT_COUNT
	int "SDIO stream packet pool size"
	default 8
	help
	  Number of packets (and data buffers) in each streaming pool.

config SDIO_STREAM_BUF_SIZE
	int "SDIO stream packet buffer size (bytes)"
	default 2048

config SDIO_STREAM_DMA_ALIGN
	int "SDIO stream buffer alignment (bytes)"
	default 4
	help
	  Alignment of stream packets and buffers, for DMA-capable controllers.

endif # SDIO_DEVICE_STREAM

endif # SDIO_DEVICE

endif # SDIO
```
